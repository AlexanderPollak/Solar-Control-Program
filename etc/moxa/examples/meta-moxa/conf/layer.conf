## etc/moxa/examples/meta-moxa/conf/layer.conf
```bitbake
# We have a conf and classes directory, add to BBPATH
BBPATH .= ":${LAYERDIR}"

# We have recipes-* directories, add to BBFILES
BBFILES += "${LAYERDIR}/recipes-*/*/*.bb \
            ${LAYERDIR}/recipes-*/*/*.bbappend"

BBFILE_COLLECTIONS += "meta-moxa"
BBFILE_PATTERN_meta-moxa = "^${LAYERDIR}/"
BBFILE_PRIORITY_meta-moxa = "6"

LAYERDEPENDS_meta-moxa = "core"
LAYERSERIES_COMPAT_meta-moxa = "dunfell"
```
